#include <ros/ros.h>
#include <cstdlib>
#include "sensor_msgs/Image.h"
#include "sensor_msgs/CameraInfo.h"
//#include "sensor_msgs/Float32MultiArray.h"
//#include "sensor_msgs/MultiArrayDimension.h"
#include "roslib/Header.h"
#include "hrl_lib/kbhit.h"
#include "pr2_overhead_grasping/SensorPoint.h"
#include <ros/package.h>

using namespace std;

float threshs[] = {9.841934, 9.841934, 9.841934, 9.841934, 9.841934, 9.841934, 18.613708, 9.187677, 9.187677, 9.187677, 9.187677, 17.681366, 17.681366,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 0.155533, 0.155533};

class Main {
  public:
    pr2_overhead_grasping::SensorPoint::ConstPtr cur_msg;
    pr2_overhead_grasping::SensorPoint::ConstPtr init_msg;
    bool msg_in;

    void callback(pr2_overhead_grasping::SensorPoint::ConstPtr msg) {
      if(!msg_in) init_msg = msg;
      msg_in = true;
      cur_msg = msg;
    }

    int32_t convToColor(int i, float v) {
      int64_t ret;
      //ret = fabs(v - init_msg->data[i]) / threshs[i] * 1000.0;
      //ret = 80.0 * log(fabs(v) / threshs[i] * 2.0) + 256.0; // * 1000.0;
      ret = fabs(v) / threshs[i] * 2000.0;
      //ROS_INFO("%d", ret);
      if(ret > 255l) ret = 255l;
      if(ret < 0l) ret = 0l;
      if(v < 0.0)
        return -ret;
      return ret;
    }


    Main(char arm) {
      msg_in = false;
      int b_len = 800;
      ros::NodeHandle nh;
      ros::Subscriber sub;
      ros::Publisher pub, pub_info;
      int32_t buffer[b_len][2000];
      if(arm == 'r')
        sub = nh.subscribe("/r_arm_features", 1,
                           &Main::callback, this);
      else
        sub = nh.subscribe("/l_arm_features", 1,
                           &Main::callback, this);
      ros::Rate r(100);

      /*double maxs[1267];
      for(int i=0;i<1267;i++)
         maxs[i] = 0.0;
      while(ros::ok()) {// && !kb_getc()) {
        
        ros::spinOnce();
        r.sleep();
        if(!msg_in)
          //break;
          continue;
        for(uint32_t i=0;i<cur_msg->features.size();i++)
          if(fabs(cur_msg->features[i]) > maxs[i])
            maxs[i] = fabs(cur_msg->features[i]);

        ROS_INFO("Waiting for features message");
      }
      for(uint32_t i=0;i<cur_msg->features.size();i++)
        printf("%f, ",maxs[i]);
      return;
      */
      while(ros::ok()) {
        ros::spinOnce();
        r.sleep();
        if(msg_in)
          break;
        ROS_INFO("Waiting for features message");
      }
      vector<int> split_inds(cur_msg->features.size(), 0);
      for(int i=0;i<cur_msg->features.size();i++) {
            if(find(cur_msg->split_inds3.begin(), cur_msg->split_inds3.end(), i)
                                     != cur_msg->split_inds3.end()) {
		split_inds[i] = 3;
            } else if(find(cur_msg->split_inds2.begin(), cur_msg->split_inds2.end(), i)
                                     != cur_msg->split_inds2.end()) {
		split_inds[i] = 2;
            } else if(find(cur_msg->split_inds1.begin(), cur_msg->split_inds1.end(), i)
                                     != cur_msg->split_inds1.end()) {
		split_inds[i] = 1;
            }
	}
      for(int i=0;i<b_len;i++) {
        for(uint32_t j=0;j<cur_msg->features.size();j++) {
          buffer[i][j] = 0; //convToColor(j, cur_msg->data[j]);
        }
      }
      pub = nh.advertise<sensor_msgs::Image>("arm_features_image", 1);
      pub_info = nh.advertise<sensor_msgs::CameraInfo>("camera_info", 1);
      int seq = 0;
      
      while(ros::ok()) {
        ros::spinOnce();
        for(uint32_t j=0;j<cur_msg->features.size();j++) {
          buffer[seq % b_len][j] = convToColor(j, cur_msg->features[j]);
        }

        roslib::Header h;
        h.seq = seq;
        h.stamp = ros::Time::now();
        h.frame_id = "base_link";
        sensor_msgs::CameraInfo cinfo;
        cinfo.header = h;
        sensor_msgs::Image img;
        img.header = h;
        img.height = b_len; img.width = cur_msg->features.size() + cur_msg->split_inds1.size() +
                                                cur_msg->split_inds2.size() +
                                                cur_msg->split_inds3.size() - 8;
        cinfo.height = img.height; cinfo.width = img.width;
        img.encoding = "rgb8";
        img.is_bigendian = false;
        img.step = img.width*3;
        
        std::vector<uint8_t> data;
        int n_markers = 0;
        for(int i=0;i<b_len - n_markers;i++) {
          if((i + seq) % 100 == 0) {
            for(uint32_t j=0;j<img.width;j++) {
              // add white second marker
              uint8_t r = 0xFF, g = 0xFF, b = 0xFF;
              data.push_back(r);
              data.push_back(g);
              data.push_back(b);
            }
            n_markers++;
            if(i == b_len - n_markers)
              break;
          }
          int ind = 0;
          for(uint32_t j=0;j<cur_msg->features.size();j++) {
            uint8_t r, g, b;
            if(split_inds[j] == 3) {
              r = 0xFF, g = 0x00, b = 0xFF;
              data.push_back(r); data.push_back(g); data.push_back(b);
              ind++;
            } else if(split_inds[j] == 2) {
              r = 0x00, g = 0xFF, b = 0xFF;
              data.push_back(r); data.push_back(g); data.push_back(b);
              ind++;
            } else if(split_inds[j] == 1) {
              r = 0xFF, g = 0xFF, b = 0xFF;
              data.push_back(r); data.push_back(g); data.push_back(b);
              ind++;
            }
            r = 0x00, g = 0x00, b = 0x00;
            if(buffer[(seq + i) % b_len][j] < 0) 
              g = (uint8_t) abs(buffer[(seq + i) % b_len][j]);
            else
              r = (uint8_t) buffer[(seq + i) % b_len][j];
            //r = (uint8_t) rand() % 256;
            //ROS_INFO("r %d, b %d", r, b);
            data.push_back(r);
            data.push_back(g);
            data.push_back(b);
              ind++;
          }
        //ROS_INFO("%d, %d", ind, img.width);
        ind = 0;
        }

        img.data = data;
        pub.publish(img);
        pub_info.publish(cinfo);

        r.sleep();
        seq++;
      }
    }


};

int main(int argc, char **argv)
{
  if(argc < 2 || (argv[1][0] != 'r' && argv[1][0] != 'l')) {
    ROS_FATAL("Must provide r or l as the parameter designating the arm.");
    return -1;
  }

  ros::init(argc, argv, "sensor_visualizer");
  Main m(argv[1][0]);

  return 0;
}

