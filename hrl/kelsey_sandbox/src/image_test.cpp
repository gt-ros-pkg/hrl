#include <ros/ros.h>
#include <cstdlib>
#include "sensor_msgs/Image.h"
#include "sensor_msgs/CameraInfo.h"
//#include "sensor_msgs/Float32MultiArray.h"
//#include "sensor_msgs/MultiArrayDimension.h"
#include "roslib/Header.h"
#include "hrl_lib/kbhit.h"
#include "pr2_overhead_grasping/SensorPoint.h"
#include <ros/package.h>

using namespace std;

float threshs[] = {19.620001, 14.216836, 19.620001, 0.955078, 0.499350, 2.024202, 1.484848, 2.394039, 1.659796, 2.603328, 11.975079, 11.689432, 6.150004,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 0.067512, 0.067356};

int data_layout[] = {0 , 0 , 0 , 0 , 0 , 0 , 0 , 0 , 0 , 0 , 0 , 0 , 0 ,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 0 , 0};
class Main {
  public:
    pr2_overhead_grasping::SensorPoint::ConstPtr cur_msg;
    pr2_overhead_grasping::SensorPoint::ConstPtr init_msg;
    bool msg_in;

    void callback(pr2_overhead_grasping::SensorPoint::ConstPtr msg) {
      if(!msg_in) init_msg = msg;
      msg_in = true;
      cur_msg = msg;
    }

    int32_t convToColor(int i, float v) {
      int64_t ret;
      //ret = fabs(v - init_msg->data[i]) / threshs[i] * 1000.0;
      //ret = 80.0 * log(fabs(v) / threshs[i] * 2.0) + 256.0; // * 1000.0;
      ret = fabs(v) / threshs[i] * 2000.0;
      //ROS_INFO("%d", ret);
      if(ret > 255l) ret = 255l;
      if(ret < 0l) ret = 0l;
      if(v < 0.0)
        return -ret;
      return ret;
    }


    Main(char arm) {
      msg_in = false;
      int b_len = 800, n_pts = 1932;
      ros::NodeHandle nh;
      ros::Subscriber sub;
      ros::Publisher pub, pub_info;
      int32_t buffer[b_len][n_pts];
      if(arm == 'r')
        sub = nh.subscribe("r_arm_features", 1,
                           &Main::callback, this);
      else
        sub = nh.subscribe("l_arm_features", 1,
                           &Main::callback, this);
      ros::Rate r(100);

      //float maxs[n_pts];
      //for(int i=0;i<n_pts;i++)
      //   maxs[i] = 0.0;
      while(ros::ok()) {// && !kb_getc()) {
        
        ros::spinOnce();
        r.sleep();
        if(msg_in)
          break;
          //continue;
        //for(int i=0;i<n_pts;i++)
        //  if(fabs(cur_msg->data[i]) > maxs[i])
        //    maxs[i] = fabs(cur_msg->data[i]);

        ROS_INFO("Waiting for features message");
      }
      //for(int i=0;i<n_pts;i++)
      //  printf("%f, ",maxs[i]);
      //return;
      for(int i=0;i<b_len;i++) {
        for(int j=0;j<n_pts;j++) {
          buffer[i][j] = 0; //convToColor(j, cur_msg->data[j]);
        }
      }
      pub = nh.advertise<sensor_msgs::Image>("arm_features_image", 1);
      pub_info = nh.advertise<sensor_msgs::CameraInfo>("camera_info", 1);
      int seq = 0;
      while(ros::ok()) {
        ros::spinOnce();
        for(int j=0;j<n_pts;j++) {
          buffer[seq % b_len][j] = convToColor(j, cur_msg->data[j]);
        }

        roslib::Header h;
        h.seq = seq;
        h.stamp = ros::Time::now();
        h.frame_id = "base_link";
        sensor_msgs::CameraInfo cinfo;
        cinfo.header = h;
        sensor_msgs::Image img;
        img.header = h;
        img.height = b_len; img.width = n_pts - 812 + 55;
        cinfo.height = img.height; cinfo.width = img.width;
        img.encoding = "rgb8";
        img.is_bigendian = false;
        img.step = n_pts*3;
        
        std::vector<uint8_t> data;
        for(int i=0;i<b_len;i++)
          for(int j=812;j<n_pts;j++) {
            if(data_layout[j] != 0) {
              uint8_t r = 0x00, g = 0x00, b = 0xFF;
              if(data_layout[j] == 1) {
                g = 0xFF;
              } else if(data_layout[j] == 3) {
                r = 0xFF;
                g = 0xFF;
              } else {
                r = 0xFF;
              }
              data.push_back(r);
              data.push_back(g);
              data.push_back(b);
            }
            uint8_t r = 0x00, g = 0x00, b = 0x00;
            if(buffer[(seq + i) % b_len][j] < 0) 
              g = (uint8_t) abs(buffer[(seq + i) % b_len][j]);
            else
              r = (uint8_t) buffer[(seq + i) % b_len][j];
            //r = (uint8_t) rand() % 256;
            //ROS_INFO("r %d, b %d", r, b);
            data.push_back(r);
            data.push_back(g);
            data.push_back(b);
          }

        img.data = data;
        pub.publish(img);
        pub_info.publish(cinfo);

        r.sleep();
        seq++;
      }
    }


};

int main(int argc, char **argv)
{
  if(argc < 2 || (argv[1][0] != 'r' && argv[1][0] != 'l')) {
    ROS_FATAL("Must provide r or l as the parameter designating the arm.");
    return -1;
  }

  ros::init(argc, argv, "image_test");
  Main m(argv[1][0]);

  return 0;
}

